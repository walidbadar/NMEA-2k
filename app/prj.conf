## CMakeLists.txt
```
# SPDX-License-Identifier: Apache-2.0

cmake_minimum_required(VERSION 3.20.0)

find_package(Zephyr REQUIRED HINTS $ENV{ZEPHYR_BASE})
project(nmea_convertor)

target_sources(app PRIVATE 
                src/main.c
                src/nmea0183.c
                src/nmea2000.c
            )
```

## prj.conf
```kconfig
# Memory and Performance
CONFIG_MAIN_STACK_SIZE=2048
CONFIG_HEAP_MEM_POOL_SIZE=4096

# CAN Bus Support
CONFIG_CAN=y
CONFIG_CAN_DEFAULT_BITRATE=250000

# UART Support
CONFIG_UART_INTERRUPT_DRIVEN=y

# Networking (for NMEA 2000 address claiming)
CONFIG_NET_BUF=y

# Logging
CONFIG_LOG=y
```

## boards/stm32f3_disco.overlay
```dts
/*
 * Copyright (c) 2025 Muhammad Waleed Badar
 *
 * SPDX-License-Identifier: Apache-2.0
 */

&usart2 {
	current-speed = <38400>;
	status = "okay";
};

/ {
    nmea_rs485_control {
        compatible = "gpio-leds";
        rs485_de: rs485_de {
            gpios = <&gpioa 1 GPIO_ACTIVE_HIGH>;
            label = "RS485 DE";
        };
    };
};
```

## src/main.c
```c
/*
 *
 * Copyright (c) 2025 Muhammad Waleed Badar
 *
 * SPDX-License-Identifier: Apache-2.0
 */

#include <nmea-2k.h>

#include <zephyr/logging/log.h>

LOG_MODULE_REGISTER(nmea_converter, LOG_LEVEL_DBG);

K_THREAD_STACK_DEFINE(can_rx_stack, STACK_SIZE);
K_THREAD_STACK_DEFINE(nmea_rx_stack, STACK_SIZE);
K_THREAD_STACK_DEFINE(converter_stack, STACK_SIZE * 2);

K_MSGQ_DEFINE(converter_msgq, sizeof(struct converter_msg), MSG_QUEUE_SIZE, 4);

static struct k_thread can_rx_tid;
static struct k_thread uart_rx_tid;
static struct k_thread converter_tid;

static const struct device *can_dev;
static const struct device *uart_dev;

static char uart_rx_buf[NMEA_MAX_LEN];
static int uart_rx_pos = 0;

void can_rx_callback(const struct device *dev, struct can_frame *frame, void *user_data)
{
	struct converter_msg msg = {.type = MSG_CAN_TO_UART, .data.can_frame = *frame};

	if (k_msgq_put(&converter_msgq, &msg, K_NO_WAIT) != 0) {
		LOG_WRN("CAN RX queue full, dropping message");
	}
}

void can_rx_thread(void *arg1, void *arg2, void *arg3)
{
	ARG_UNUSED(arg1);
	ARG_UNUSED(arg2);
	ARG_UNUSED(arg3);

	struct can_filter filter = {.flags = CAN_FILTER_IDE, .id = 0, .mask = 0};

	int filter_id = can_add_rx_filter(can_dev, can_rx_callback, NULL, &filter);
	if (filter_id < 0) {
		LOG_ERR("Failed to add CAN filter");
		return;
	}

	LOG_INF("CAN RX thread started");

	while (1) {
		k_sleep(K_FOREVER);
	}
}

void uart_rx_callback(const struct device *dev, void *user_data)
{
	uint8_t c;

	while (uart_poll_in(dev, &c) == 0) {
		if (c == '\n') {
			uart_rx_buf[uart_rx_pos] = '\0';

			if (uart_rx_pos > 0 && uart_rx_buf[0] == '$') {
				struct converter_msg msg = {.type = MSG_UART_TO_CAN};
				strncpy(msg.data.nmea_sentence, uart_rx_buf, NMEA_MAX_LEN);

				if (k_msgq_put(&converter_msgq, &msg, K_NO_WAIT) != 0) {
					LOG_WRN("NMEA RX queue full");
				}
			}

			uart_rx_pos = 0;
		} else if (c != '\r' && uart_rx_pos < NMEA_MAX_LEN - 1) {
			uart_rx_buf[uart_rx_pos++] = c;
		}
	}
}

void uart_rx_thread(void *arg1, void *arg2, void *arg3)
{
	ARG_UNUSED(arg1);
	ARG_UNUSED(arg2);
	ARG_UNUSED(arg3);

	uart_irq_callback_set(uart_dev, uart_rx_callback);
	uart_irq_rx_enable(uart_dev);

	LOG_INF("NMEA RX thread started");

	while (1) {
		k_sleep(K_FOREVER);
	}
}

void converter_thread(void *arg1, void *arg2, void *arg3)
{
	ARG_UNUSED(arg1);
	ARG_UNUSED(arg2);
	ARG_UNUSED(arg3);

	struct converter_msg msg;
	struct can_frame frame;

	LOG_INF("Converter thread started");

	while (1) {
		if (k_msgq_get(&converter_msgq, &msg, K_FOREVER) == 0) {
			if (msg.type == MSG_CAN_TO_UART) {
				char nmea_out[NMEA_MAX_LEN];
				if (convert_nmea2000_to_nmea0183(&msg.data.can_frame, nmea_out,
								 sizeof(nmea_out)) == 0) {

					for (int i = 0; nmea_out[i]; i++) {
						uart_poll_out(uart_dev, nmea_out[i]);
					}
					LOG_DBG("CAN->NMEA: %s", nmea_out);
				}
			} else if (msg.type == MSG_UART_TO_CAN) {
				if (convert_nmea0183_to_nmea2000(msg.data.nmea_sentence, &frame) ==
				    0) {
					if (can_send(can_dev, &frame, K_MSEC(100), NULL, NULL) !=
					    0) {
						LOG_ERR("Failed to send CAN frame");
					}
					LOG_DBG("NMEA->CAN: %s", msg.data.nmea_sentence);
				}
			}
		}
	}
}

int main(void)
{
	LOG_INF("NMEA 2000 <-> NMEA 0183 Converter Starting");

	can_dev = DEVICE_DT_GET(NMEA2000_CAN_NODE);
	if (!device_is_ready(can_dev)) {
		LOG_ERR("CAN device not ready");
		return -ENODEV;
	}

	uart_dev = DEVICE_DT_GET(NMEA0183_UART_NODE);
	if (!device_is_ready(uart_dev)) {
		LOG_ERR("UART device not ready");
		return -ENODEV;
	}

	struct uart_config uart_cfg = {.baudrate = NMEA0183_BAUD_RATE,
				       .parity = UART_CFG_PARITY_NONE,
				       .stop_bits = UART_CFG_STOP_BITS_1,
				       .data_bits = UART_CFG_DATA_BITS_8,
				       .flow_ctrl = UART_CFG_FLOW_CTRL_NONE};

	uart_configure(uart_dev, &uart_cfg);
	LOG_INF("UART initialized at %d bps", NMEA0183_BAUD_RATE);

	k_thread_create(&can_rx_tid, can_rx_stack, STACK_SIZE, can_rx_thread, NULL, NULL, NULL,
			K_PRIO_PREEMPT(7), 0, K_NO_WAIT);

	k_thread_create(&uart_rx_tid, nmea_rx_stack, STACK_SIZE, uart_rx_thread, NULL, NULL, NULL,
			K_PRIO_PREEMPT(7), 0, K_NO_WAIT);

	k_thread_create(&converter_tid, converter_stack, STACK_SIZE * 2, converter_thread, NULL,
			NULL, NULL, K_PRIO_PREEMPT(8), 0, K_NO_WAIT);

	LOG_INF("All threads started");

	return 0;
}
```

## src/nmea0183.c
```c
/*
 *
 * Copyright (c) 2025 Muhammad Waleed Badar
 *
 * SPDX-License-Identifier: Apache-2.0
 */

#include <nmea-2k.h>

#include <zephyr/logging/log.h>

LOG_MODULE_REGISTER(nmea0183, LOG_LEVEL_DBG);

static int parse_nmea0183_field(const char *sentence, int field_num, char *field, size_t field_len)
{
	const char *start = sentence;
	int current_field = 0;

	while (*start && current_field < field_num) {
		if (*start == ',') {
			current_field++;
		}
		start++;
	}

	if (current_field != field_num) {
		return -1;
	}

	const char *end = start;
	while (*end && *end != ',' && *end != '*') {
		end++;
	}

	size_t len = end - start;
	if (len >= field_len) {
		len = field_len - 1;
	}

	memcpy(field, start, len);
	field[len] = '\0';

	return 0;
}

int convert_nmea0183_to_nmea2000(const char *nmea_in, struct can_frame *frame)
{
	char talker[3] = {0};
	char sentence_type[4] = {0};

	// Extract sentence type (e.g., $HEHDT or $GPRMC)
	if (nmea_in[0] != '$') {
		return -1;
	}

	memcpy(talker, &nmea_in[1], 2);
	const char *type_start = &nmea_in[3];
	int i = 0;
	while (type_start[i] && type_start[i] != ',' && i < 3) {
		sentence_type[i] = type_start[i];
		i++;
	}

	if (strcmp(sentence_type, "HDT") == 0) {
		// PGN 127250 - Vessel Heading
		char heading_str[16];
		if (parse_nmea0183_field(nmea_in, 1, heading_str, sizeof(heading_str)) == 0) {
			float heading = atof(heading_str);
			uint16_t heading_raw = (uint16_t)(heading / 57.2958 / 0.0001);

			frame->id = CAN_EFF_FLAG | (6 << 26) | (127250 << 8) | 0xFF;
			frame->dlc = 8;
			frame->data[0] = 0xFF; // SID
			frame->data[1] = heading_raw & 0xFF;
			frame->data[2] = (heading_raw >> 8) & 0xFF;
			frame->data[3] = 0xFF; // Deviation
			frame->data[4] = 0xFF;
			frame->data[5] = 0xFF; // Variation
			frame->data[6] = 0xFF;
			frame->data[7] = 0x00; // Reference (True)

			return 0;
		}
	} else if (strcmp(sentence_type, "DPT") == 0) {
		// PGN 128267 - Water Depth
		char depth_str[16];
		if (parse_nmea0183_field(nmea_in, 1, depth_str, sizeof(depth_str)) == 0) {
			float depth = atof(depth_str);
			uint32_t depth_cm = (uint32_t)(depth * 100);

			frame->id = CAN_EFF_FLAG | (6 << 26) | (128267 << 8) | 0xFF;
			frame->dlc = 8;
			frame->data[0] = 0xFF; // SID
			frame->data[1] = depth_cm & 0xFF;
			frame->data[2] = (depth_cm >> 8) & 0xFF;
			frame->data[3] = (depth_cm >> 16) & 0xFF;
			frame->data[4] = (depth_cm >> 24) & 0xFF;
			frame->data[5] = 0xFF; // Offset
			frame->data[6] = 0xFF;
			frame->data[7] = 0xFF; // Max range

			return 0;
		}
	}

	LOG_DBG("Unhandled sentence type: %s", sentence_type);
	return -EINVAL;
}
```

## src/nmea2000.c
```c
/*
 *
 * Copyright (c) 2025 Muhammad Waleed Badar
 *
 * SPDX-License-Identifier: Apache-2.0
 */

#include <nmea-2k.h>

#include <zephyr/logging/log.h>

LOG_MODULE_REGISTER(nmea2000, LOG_LEVEL_DBG);

int convert_nmea2000_to_nmea0183(const struct can_frame *frame, char *nmea_out, size_t max_len)
{
	uint32_t pgn = (frame->id >> 8) & 0x1FFFF;

	switch (pgn) {
	case 127250: { // Vessel Heading
		// Extract heading from CAN data (simplified)
		uint16_t heading_raw = (frame->data[1] << 8) | frame->data[0];
		float heading = heading_raw * 0.0001; // radians to degrees conversion
		heading = heading * 57.2958;

		// Generate HDT sentence
		snprintf(nmea_out, max_len, "$HEHDT,%.1f,T", heading);
		uint8_t cs = calculate_nmea_checksum(nmea_out);
		snprintf(nmea_out + strlen(nmea_out), max_len - strlen(nmea_out), "*%02X\r\n", cs);
		return 0;
	}

	case 128267: { // Water Depth
		uint32_t depth_cm = (frame->data[3] << 24) | (frame->data[2] << 16) |
				    (frame->data[1] << 8) | frame->data[0];
		float depth = depth_cm * 0.01;

		// Generate DPT sentence
		snprintf(nmea_out, max_len, "$HEDPT,%.2f,0.0,", depth);
		uint8_t cs = calculate_nmea_checksum(nmea_out);
		snprintf(nmea_out + strlen(nmea_out), max_len - strlen(nmea_out), "*%02X\r\n", cs);
		return 0;
	}

	case 129026: { // COG & SOG
		uint16_t cog_raw = (frame->data[3] << 8) | frame->data[2];
		uint16_t sog_raw = (frame->data[5] << 8) | frame->data[4];
		float cog = cog_raw * 0.0001 * 57.2958;
		float sog = sog_raw * 0.01 * 1.94384; // m/s to knots

		// Generate VTG sentence
		snprintf(nmea_out, max_len, "$HEVTG,%.1f,T,%.1f,M,%.2f,N,%.2f,K,A", cog, cog, sog,
			 sog * 1.852);
		uint8_t cs = calculate_nmea_checksum(nmea_out);
		snprintf(nmea_out + strlen(nmea_out), max_len - strlen(nmea_out), "*%02X\r\n", cs);
		return 0;
	}

	default:
		LOG_DBG("Unhandled PGN: %u", pgn);
		return -EINVAL;
	}
}
```
